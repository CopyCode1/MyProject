## CMakeLists.txt
```
cmake_minimum_required(VERSION 3.20.0)
find_package(Zephyr REQUIRED HINTS $ENV{ZEPHYR_BASE})
project(gt02_at_test)
# 使用真实AT核心及SDK解析器，通过操作表注入假I/O，不链接任何硬件适配实现。
target_sources(app PRIVATE ../../adapters/modem/gt02_modem_at.c
    ../../adapters/modem/gt02_modem_lierda.c)
if(CONFIG_AT_TEST_RECOVERY)
    target_sources(app PRIVATE src/recovery.c ../../services/network/gt02_network_service.c)
elseif(CONFIG_AT_TEST_NETWORK)
    target_sources(app PRIVATE src/network.c ../../services/network/gt02_network_service.c)
elseif(CONFIG_AT_TEST_CAPABILITY)
    target_sources(app PRIVATE src/capability.c)
elseif(CONFIG_AT_TEST_QUERY_ALL)
    target_sources(app PRIVATE src/query_all.c ../bringup/gt02_modem_at_test.c)
else()
    target_sources(app PRIVATE src/main.c)
endif()
target_include_directories(app PRIVATE ../.. ${ZEPHYR_BASE}/drivers/modem)
```

## Kconfig
```
mainmenu "GT02 AT core tests"
source "Kconfig.zephyr"

config AT_TEST_RECOVERY
	bool "Verify bounded isolation and session recovery"
	select IRQ_OFFLOAD
	default n

config AT_TEST_RECOVERY_CASE
	int "Recovery: core=0, service=1, failures=2..9, blocked rearm=10, blocked power off=11"
	depends on AT_TEST_RECOVERY
	range 0 11
	default 0

config AT_TEST_FAULT_CASE
	int "Final fault: timeout=0, partial TX=1, long line=2, long body=3, RX error=4"
	range 0 4
	default 0

config AT_TEST_QUERY_ALL
	bool "Run real one-shot information bring-up with fake power/UART"
	default n

config AT_TEST_CAPABILITY
	bool "Verify unified protocol operations and typed completion events"
	default n

config AT_TEST_NETWORK
	bool "Run periodic network readiness monitor with fake hardware"
	default n

config AT_TEST_NETWORK_CASE
	int "Network: readiness/fault=0..18, PDP activation sequence/failures=19..25"
	depends on AT_TEST_NETWORK
	range 0 25
	default 0

config AT_TEST_QUERY_FAULT_CASE
	int "Query sweep fault: none=0, clock ERROR=1, SIM timeout=2"
	depends on AT_TEST_QUERY_ALL
	range 0 2
	default 0
```

## prj.conf
```kconfig
CONFIG_ZTEST=y
CONFIG_LOG=y
CONFIG_LOG_DEFAULT_LEVEL=2
CONFIG_MODEM=y
CONFIG_MODEM_CONTEXT=y
CONFIG_MODEM_CMD_HANDLER=y
CONFIG_MAIN_STACK_SIZE=2048
CONFIG_LOG_BUFFER_SIZE=4096
CONFIG_TEST_EXTRA_STACK_SIZE=2048
```

## src/main.c
```c
/** @file
 * @brief QEMU假串口测试，真实执行SDK文本解析和AT核心，不接触GPIO或实物电源。
 */
#include <errno.h>
#include <string.h>
#include <zephyr/kernel.h>
#include <zephyr/sys/atomic.h>
#include <zephyr/ztest.h>

#include "adapters/modem/gt02_modem_at.h"
#include "adapters/modem/gt02_modem_lierda.h"

/* ID同时用于回调核对顺序；HOLD用于验证超时隔离或传输/解析故障。 */
enum command_id {
	AT = 1, CSQ, REJECT, MISSING, MULTI, EXT_ERROR, HOLD,
	PLAIN, PLAIN_ERROR, PLAIN_MISSING, RESERVED,
	LATE_READ,
	PARAM = 100, LGPIO = LIERDA_CMD_LGPIO,
};
struct completion {
	int id;                 /* 命令表注册的ID。 */
	enum gt02_at_result result; /* 最终结果。 */
	size_t size;            /* 交付正文字节数。 */
	bool null_body;         /* 失败必须不交付正文。 */
	char text[513];         /* 仅测试保存回调快照，避免引用核心复用的缓存。 */
};

K_MSGQ_DEFINE(rx_bytes, sizeof(uint8_t), 2048, 1);
K_MSGQ_DEFINE(tx_events, sizeof(int), 32, 4);
K_MSGQ_DEFINE(completions, sizeof(struct completion), 16, 4);
K_MSGQ_DEFINE(parameter_tx, GT02_AT_COMMAND_MAX + 1, 16, 1);
K_SEM_DEFINE(release_tx, 0, 1);
static atomic_t urc_count;
static atomic_t follow_up;
static atomic_t follow_up_result;
static atomic_t rx_error;
static atomic_t late_read;
static size_t fragment_size = 1;
static unsigned int extended_errors;
static int callback_ids[] = {
	AT, CSQ, REJECT, MISSING, MULTI, EXT_ERROR, HOLD, PLAIN, PLAIN_ERROR, PLAIN_MISSING,
	PARAM, LGPIO, LATE_READ,
};

/* 往假的UART队列放入原始字节，允许故意构造拆包、NUL和超长输入。 */
static void inject_bytes(const char *text, size_t length)
{
	for (size_t i = 0; i < length; ++i) {
		zassert_ok(k_msgq_put(&rx_bytes, &text[i], K_NO_WAIT), "fake RX queue full");
	}
}

/* C字符串样例的简便入口，不适用于包含NUL的输入。 */
static void inject_text(const char *text)
{
	inject_bytes(text, strlen(text));
}

/* 假硬件保留实际超时和分片读取语义，由测试选择单字节或64字节一批。 */
static int fake_read(uint8_t *buffer, size_t capacity, size_t *received, k_timeout_t timeout)
{
	*received = 0;
	if (atomic_cas(&rx_error, 1, 0)) {
		return -EIO;
	}
	if (atomic_cas(&late_read, 1, 0)) {
		/* 模拟read期间跨过200ms事务期限，但本次read仍交回旧OK。 */
		k_sleep(K_MSEC(250));
		zassert_true(capacity >= 4);
		memcpy(buffer, "OK\r\n", 4);
		*received = 4;
		return 0;
	}
	int ret = k_msgq_get(&rx_bytes, buffer, timeout);

	if (ret != 0) {
		return -EAGAIN;
	}
	*received = 1;
	while (*received < MIN(capacity, fragment_size) &&
	       k_msgq_get(&rx_bytes, &buffer[*received], K_NO_WAIT) == 0) {
		++*received;
	}
	return 0;
}

/* 假write核对CRLF并立即回包；HOLD有意等待测试填满待执行队列后再注入故障。 */
static int fake_write(const uint8_t *buffer, size_t length, size_t *written)
{
	char command[131];
	int id;

	zassert_true(length < sizeof(command));
	zassert_mem_equal(&buffer[length - 2], "\r\n", 2);
	memcpy(command, buffer, length - 2);
	command[length - 2] = '\0';
	*written = length;
	if (strcmp(command, "AT") == 0) {
		id = AT;
		inject_text("AT\r\nOKAY\r\nRDY\r\nOK\r\n");
	} else if (strcmp(command, "AT+CSQ") == 0) {
		id = CSQ;
		inject_text("+CSQ: 18,0\r\nRDY\r\nOK\r\n");
	} else if (strcmp(command, "AT+REJECT") == 0) {
		id = REJECT;
		inject_text("+CSQ: 18,0\r\nERROR\r\n");
	} else if (strcmp(command, "AT+MISSING") == 0) {
		id = MISSING;
		inject_text("OK\r\n");
	} else if (strcmp(command, "AT+MULTI") == 0) {
		id = MULTI;
		inject_text("+CSQ: 18,0\r\n+CSQ: 19,1\r\nOK\r\n");
	} else if (strcmp(command, "AT+EXT") == 0) {
		id = EXT_ERROR;
		inject_text(extended_errors++ == 0 ? "+CME ERROR: 13\r\n" : "+CMS ERROR: 500\r\n");
	} else if (strcmp(command, "AT+LATE") == 0) {
		id = LATE_READ;
		atomic_set(&late_read, 1);
	} else if (strcmp(command, "ATI") == 0) {
		id = PLAIN;
		inject_text("ATI\r\nLierda\r\nRDY\r\nNT26-KCN\r\nRevision: test\r\nOK\r\n");
	} else if (strcmp(command, "AT+PLAINERR") == 0) {
		id = PLAIN_ERROR;
		inject_text("123456789012345\r\nERROR\r\n");
	} else if (strcmp(command, "AT+PLAINMISSING") == 0) {
		id = PLAIN_MISSING;
		inject_text("RDY\r\nOK\r\n");
	} else if (strncmp(command, "AT+PARAM=", 9) == 0 || strncmp(command, "AT+LGPIO=", 9) == 0) {
		id = command[3] == 'P' ? PARAM : LGPIO;
		/* 固定长度队列保存TX快照，不借用本函数栈；未使用的尾部清零。 */
		memset(command + strlen(command) + 1, 0, sizeof(command) - strlen(command) - 1);
		zassert_ok(k_msgq_put(&parameter_tx, command, K_NO_WAIT));
		zassert_ok(k_msgq_put(&tx_events, &id, K_NO_WAIT));
		if (strcmp(command, "AT+PARAM=hold") == 0) {
			zassert_ok(k_sem_take(&release_tx, K_SECONDS(2)), "parameter hold not released");
		}
		/* 参数化回显必须按本次完整文本过滤，而非表中的命令名。 */
		inject_text(command);
		inject_text("\r\nparameter body\r\nOK\r\n");
		return 0;
	} else {
		id = HOLD;
		zassert_equal(strcmp(command, "AT+HOLD"), 0);
		zassert_ok(k_msgq_put(&tx_events, &id, K_NO_WAIT));
		zassert_ok(k_sem_take(&release_tx, K_SECONDS(2)), "test did not release TX");
		switch (CONFIG_AT_TEST_FAULT_CASE) {
		case 1:
			*written = 1;
			return -EIO;
		case 2: {
			char oversized[257];

			memset(oversized, 'X', sizeof(oversized));
			inject_bytes(oversized, sizeof(oversized));
			inject_text("\r\nOK\r\n");
			break;
		}
		case 3:
			for (int i = 0; i < 50; ++i) {
				inject_text("+CSQ: 18,0\r\n");
			}
			inject_text("OK\r\n");
			break;
		case 4:
			atomic_set(&rx_error, 1);
			break;
		default:
			break;
		}
		return 0;
	}
	zassert_ok(k_msgq_put(&tx_events, &id, K_NO_WAIT));
	return 0;
}

/* 保存最终回调快照；可选从回调再入队，验证核心没有持请求锁调用用户函数。 */
static void on_complete(enum gt02_at_result result, const char *response,
			size_t length, void *user_data)
{
	struct completion done = {
		.id = *(int *)user_data, .result = result, .size = length,
		.null_body = response == NULL,
	};

	zassert_true(length < sizeof(done.text));
	if (response != NULL) {
		memcpy(done.text, response, length);
		zassert_equal(response[length], '\0');
	}
	if (done.id == AT && atomic_cas(&follow_up, 1, 0)) {
		atomic_set(&follow_up_result, gt02_at_submit(CSQ));
	}
	zassert_ok(k_msgq_put(&completions, &done, K_NO_WAIT), "duplicate/unconsumed callback");
}

/* 验证完整行、参数指针和终止符有效期，不阻塞AT线程。 */
static void on_urc(const char *content, size_t length, void *user_data)
{
	zassert_equal(length, 3);
	zassert_mem_equal(content, "RDY", 3);
	zassert_equal(content[length], '\0');
	zassert_equal_ptr(user_data, &urc_count);
	atomic_inc(&urc_count);
}

static const struct gt02_at_command commands[] = {
	{ AT, "AT", NULL, on_complete, &callback_ids[0], 200, false, false, false },
	{ CSQ, "AT+CSQ", "+CSQ:", on_complete, &callback_ids[1], 200, true, false, false },
	{ REJECT, "AT+REJECT", "+CSQ:", on_complete, &callback_ids[2], 200, true, false, false },
	{ MISSING, "AT+MISSING", "+CSQ:", on_complete, &callback_ids[3], 200, true, false, false },
	{ MULTI, "AT+MULTI", "+CSQ:", on_complete, &callback_ids[4], 200, true, false, false },
	{ EXT_ERROR, "AT+EXT", NULL, on_complete, &callback_ids[5], 200, false, false, false },
	{ HOLD, "AT+HOLD", "+CSQ:", on_complete, &callback_ids[6], 200, true, false, false },
	{ PLAIN, "ATI", "", on_complete, &callback_ids[7], 200, true, false, false },
	{ PLAIN_ERROR, "AT+PLAINERR", "", on_complete, &callback_ids[8], 200, true, false, false },
	{ PLAIN_MISSING, "AT+PLAINMISSING", "", on_complete, &callback_ids[9], 200, true, false, false },
	{ .id = RESERVED, .command = "AT+QISEND=%hhu,%hu", .timeout_ms = 10000,
	  .reserved = true },
	{ PARAM, "AT+PARAM", "", on_complete, &callback_ids[10], 200, true, false, true },
	{ LGPIO, "AT+LGPIO", "", on_complete, &callback_ids[11], 200, true, false, true },
	{ LATE_READ, "AT+LATE", NULL, on_complete, &callback_ids[12], 200, false, false, false },
};
static const struct gt02_at_urc urcs[] = {
	{ "RDY", true, on_urc, &urc_count },
};
static const struct gt02_at_profile profile = {
	.commands = commands, .command_count = ARRAY_SIZE(commands),
	.urcs = urcs, .urc_count = ARRAY_SIZE(urcs),
};

/* 显式注入静态假I/O，不导出任何同名硬件函数，验证AT核心可独立于Zephyr适配器链接。 */
static const struct gt02_at_io_ops fake_io = {
	.read = fake_read,
	.write = fake_write,
};
static const struct gt02_at_config configuration = {
	.profile = &profile,
	.io = &fake_io,
};

/* 同时检查实际TX和最终回调的顺序，失败时必须清空交付正文。 */
static struct completion expect_result(int id, enum gt02_at_result result)
{
	struct completion done;
	int sent;

	zassert_ok(k_msgq_get(&tx_events, &sent, K_SECONDS(2)));
	zassert_equal(sent, id, "TX FIFO order");
	zassert_ok(k_msgq_get(&completions, &done, K_SECONDS(2)));
	zassert_equal(done.id, id, "callback order");
	zassert_equal(done.result, result);
	if (result != GT02_AT_SUCCESS) {
		zassert_true(done.null_body);
		zassert_equal(done.size, 0);
	}
	return done;
}

/* 验证同一ID的不同参数、局部缓存复用及在途/排队槽位隔离，不驱动实物GPIO。 */
static void check_parameter_requests(void)
{
	char text[GT02_AT_COMMAND_MAX + 2];
	char sent_text[GT02_AT_COMMAND_MAX + 1];
	struct completion done;
	int sent;

	zassert_equal(gt02_at_submit(PARAM), -EINVAL);
	zassert_equal(gt02_at_submit_text(AT, "AT=1"), -EINVAL);
	zassert_equal(gt02_at_submit_text(PARAM, NULL), -EINVAL);
	zassert_equal(gt02_at_submit_text(PARAM, ""), -EINVAL);
	zassert_equal(gt02_at_submit_text(PARAM, "AT+PARAM"), -EINVAL);
	zassert_equal(gt02_at_submit_text(PARAM, "AT+PARAM="), -EINVAL);
	zassert_equal(gt02_at_submit_text(PARAM, "AT+PARAMETER=1"), -EINVAL);
	zassert_equal(gt02_at_submit_text(PARAM, "AT+PARAM=1\r\nAT"), -EINVAL);
	zassert_equal(gt02_at_submit_text(PARAM, "AT+PARAM=\x01"), -EINVAL);
	zassert_equal(gt02_at_submit_text(PARAM, "AT+PARAM=\x80"), -EINVAL);
	zassert_equal(gt02_at_submit_text(RESERVED, "AT+QISEND=1,1"), -ENOTSUP);
	zassert_equal(gt02_lierda_gpio_config(96), -EINVAL);
	zassert_equal(gt02_lierda_gpio_set(100, true), -EINVAL);
	memset(text, 'X', sizeof(text) - 1);
	memcpy(text, "AT+PARAM=", 9);
	text[sizeof(text) - 1] = '\0';
	zassert_equal(gt02_at_submit_text(PARAM, text), -EMSGSIZE);
	text[GT02_AT_COMMAND_MAX] = '\0';
	zassert_ok(gt02_at_submit_text(PARAM, text));
	done = expect_result(PARAM, GT02_AT_SUCCESS);
	zassert_equal(strcmp(done.text, "parameter body"), 0);
	zassert_ok(k_msgq_get(&parameter_tx, sent_text, K_SECONDS(2)));
	zassert_equal(strlen(sent_text), GT02_AT_COMMAND_MAX);
	zassert_equal(strcmp(sent_text, text), 0);

	/* 在途命令停在write里，四个排队请求绕回队列；它们不能覆盖在途文本。 */
	zassert_ok(gt02_at_submit_text(PARAM, "AT+PARAM=hold"));
	zassert_ok(k_msgq_get(&tx_events, &sent, K_SECONDS(2)));
	zassert_equal(sent, PARAM);
	zassert_ok(k_msgq_get(&parameter_tx, sent_text, K_SECONDS(2)));
	zassert_equal(strcmp(sent_text, "AT+PARAM=hold"), 0);
	strcpy(text, "AT+PARAM=first");
	zassert_ok(gt02_at_submit_text(PARAM, text));
	strcpy(text, "AT+PARAM=second");
	zassert_ok(gt02_at_submit_text(PARAM, text));
	memset(text, 'Z', sizeof(text));
	zassert_ok(gt02_lierda_gpio_config(97));
	zassert_ok(gt02_lierda_gpio_set(99, false));
	zassert_equal(gt02_at_submit_text(PARAM, "AT+PARAM=extra"), -ENOBUFS);
	zassert_equal(gt02_at_submit(CSQ), -ENOBUFS);
	k_sem_give(&release_tx);
	zassert_ok(k_msgq_get(&completions, &done, K_SECONDS(2)));
	zassert_equal(done.id, PARAM);
	zassert_equal(done.result, GT02_AT_SUCCESS);
	zassert_equal(strcmp(done.text, "parameter body"), 0);
	const char *expected[] = {
		"AT+PARAM=first", "AT+PARAM=second", "AT+LGPIO=97,1", "AT+LGPIO=99,1,0",
	};

	for (size_t i = 0; i < ARRAY_SIZE(expected); ++i) {
		done = expect_result(i < 2 ? PARAM : LGPIO, GT02_AT_SUCCESS);
		zassert_equal(strcmp(done.text, "parameter body"), 0);
		zassert_ok(k_msgq_get(&parameter_tx, sent_text, K_SECONDS(2)));
		zassert_equal(strcmp(sent_text, expected[i]), 0);
	}
	zassert_ok(gt02_lierda_gpio_set(97, true));
	expect_result(LGPIO, GT02_AT_SUCCESS);
	zassert_ok(k_msgq_get(&parameter_tx, sent_text, K_SECONDS(2)));
	zassert_equal(strcmp(sent_text, "AT+LGPIO=97,1,1"), 0);
}

/* 单次开机先验证所有可继续的路径，再注入一种停止性故障，符合生产核心无reset的约束。 */
ZTEST(gt02_at, test_protocol_and_fault)
{
	zassert_equal(gt02_at_submit(AT), -EACCES);
	zassert_equal(gt02_at_submit_text(PARAM, "AT+PARAM=1"), -EACCES);
	zassert_equal(gt02_at_init(NULL), -EINVAL);
	struct gt02_at_config invalid_config = configuration;
	struct gt02_at_io_ops invalid_io = fake_io;

	invalid_config.io = NULL;
	zassert_equal(gt02_at_init(&invalid_config), -EINVAL);
	invalid_config.io = &invalid_io;
	invalid_io.read = NULL;
	zassert_equal(gt02_at_init(&invalid_config), -EINVAL);
	invalid_io = fake_io;
	invalid_io.write = NULL;
	zassert_equal(gt02_at_init(&invalid_config), -EINVAL);
	invalid_config = configuration;
	invalid_config.profile = NULL;
	zassert_equal(gt02_at_init(&invalid_config), -EINVAL);
	struct gt02_at_profile invalid = profile;
	struct gt02_at_command duplicate[2] = { commands[0], commands[0] };

	invalid.commands = duplicate;
	invalid.command_count = 2;
	invalid_config = configuration;
	invalid_config.profile = &invalid;
	zassert_equal(gt02_at_init(&invalid_config), -EINVAL);
	struct gt02_at_urc conflict = { "+CSQ:", false, on_urc, NULL };

	invalid = profile;
	invalid.urcs = &conflict;
	zassert_equal(gt02_at_init(&invalid_config), -EINVAL);
	struct gt02_at_command bad_command = {
		.id = PARAM, .command = "AT+BAD=1", .callback = on_complete,
		.timeout_ms = 200, .parameterized = true,
	};

	invalid = profile;
	invalid.commands = &bad_command;
	invalid.command_count = 1;
	zassert_equal(gt02_at_init(&invalid_config), -EINVAL);
	zassert_ok(gt02_at_init(&configuration));
	zassert_equal(gt02_at_init(&configuration), -EALREADY);
	zassert_equal(gt02_at_submit(999), -EINVAL);
	/* 预留模板不得入队、发送或回调；启用项仍要求最终回调。 */
	zassert_equal(gt02_at_submit(RESERVED), -ENOTSUP);
	struct gt02_at_config lierda_config = { .profile = &gt02_lierda_at_profile, .io = &fake_io };

	/* init先检查协议表，再检查已初始化状态；此返回值确认真实厂家表通过冲突校验。 */
	zassert_equal(gt02_at_init(&lierda_config), -EALREADY);
	size_t reserved_count = 0;

	zassert_equal(gt02_lierda_at_profile.command_count, LIERDA_CMD_COUNT);
	for (size_t i = 0; i < gt02_lierda_at_profile.command_count; ++i) {
		const struct gt02_at_command *cmd = &gt02_lierda_at_profile.commands[i];

		reserved_count += cmd->reserved;
		zassert_true(cmd->reserved || strchr(cmd->command, '%') == NULL,
			     "format template must never be executable");
	}
	zassert_equal(reserved_count, 8);
	/* 无事务的孤立OK不能抢先完成之后的命令。 */
	inject_text("OK\r\n");
	k_sleep(K_MSEC(40));
	zassert_ok(gt02_at_submit(AT));
	struct completion done = expect_result(AT, GT02_AT_SUCCESS);

	zassert_true(done.null_body);
	zassert_equal(atomic_get(&urc_count), 1);
	zassert_ok(gt02_at_submit(CSQ));
	done = expect_result(CSQ, GT02_AT_SUCCESS);
	zassert_equal(strcmp(done.text, "+CSQ: 18,0"), 0);
	zassert_equal(atomic_get(&urc_count), 2);
	/* 兜底收集保留多行原文，排除回显、已注册URC和最终结果。 */
	zassert_ok(gt02_at_submit(PLAIN));
	done = expect_result(PLAIN, GT02_AT_SUCCESS);
	zassert_equal(strcmp(done.text, "Lierda\nNT26-KCN\nRevision: test"), 0);
	zassert_equal(atomic_get(&urc_count), 3);
	zassert_ok(gt02_at_submit(PLAIN_ERROR));
	expect_result(PLAIN_ERROR, GT02_AT_FAILED);
	zassert_ok(gt02_at_submit(PLAIN_MISSING));
	expect_result(PLAIN_MISSING, GT02_AT_FAILED);
	zassert_equal(atomic_get(&urc_count), 4);
	zassert_ok(gt02_at_submit(REJECT));
	expect_result(REJECT, GT02_AT_FAILED);
	zassert_ok(gt02_at_submit(MISSING));
	expect_result(MISSING, GT02_AT_FAILED);
	zassert_ok(gt02_at_submit(EXT_ERROR));
	expect_result(EXT_ERROR, GT02_AT_FAILED);
	zassert_ok(gt02_at_submit(EXT_ERROR));
	expect_result(EXT_ERROR, GT02_AT_FAILED);
	/* 后半段使用同批次多行，覆盖粘包和正文共享缓存。 */
	fragment_size = 64;
	zassert_ok(gt02_at_submit(MULTI));
	done = expect_result(MULTI, GT02_AT_SUCCESS);
	zassert_equal(strcmp(done.text, "+CSQ: 18,0\n+CSQ: 19,1"), 0);
	atomic_set(&follow_up, 1);
	zassert_ok(gt02_at_submit(AT));
	expect_result(AT, GT02_AT_SUCCESS);
	expect_result(CSQ, GT02_AT_SUCCESS);
	zassert_equal(atomic_get(&follow_up_result), 0);
	check_parameter_requests();

	/* HOLD停在假write中，先填满4个排队位置，再验证超时/故障及每条请求的单次回调。 */
	zassert_ok(gt02_at_submit(HOLD));
	int sent;

	zassert_ok(k_msgq_get(&tx_events, &sent, K_SECONDS(2)));
	zassert_equal(sent, HOLD);
	for (int i = 0; i < 4; ++i) {
		zassert_ok(i % 2 == 0 ? gt02_at_submit_text(PARAM, "AT+PARAM=cancel") : gt02_at_submit(CSQ));
	}
	zassert_equal(gt02_at_submit(CSQ), -ENOBUFS);
	zassert_equal(gt02_at_submit(RESERVED), -ENOTSUP);
	k_sem_give(&release_tx);
	zassert_ok(k_msgq_get(&completions, &done, K_SECONDS(2)));
	zassert_equal(done.id, HOLD);
	zassert_equal(done.result, CONFIG_AT_TEST_FAULT_CASE == 0 ?
		      GT02_AT_TIMEOUT : GT02_AT_FAILED);
	zassert_true(done.null_body);
	for (int i = 0; i < 4; ++i) {
		zassert_ok(k_msgq_get(&completions, &done, K_SECONDS(2)));
		zassert_equal(done.id, i % 2 == 0 ? PARAM : CSQ);
		zassert_equal(done.result, GT02_AT_FAILED);
		zassert_true(done.null_body);
	}
	int unavailable = CONFIG_AT_TEST_FAULT_CASE == 0 ? -EAGAIN : -EPIPE;

	zassert_equal(gt02_at_submit(AT), unavailable);
	zassert_equal(gt02_at_submit_text(PARAM, "AT+PARAM=late"), unavailable);
	zassert_equal(gt02_at_init(&configuration), -EALREADY);
	/* 静默和迟到正文均不能提前恢复；隔离时URC仍分发，超时请求不能再收到回调。 */
	int previous_urcs = atomic_get(&urc_count);

	inject_text("+CSQ: 31,0\r\nRDY\r\n");
	k_sleep(K_MSEC(60));
	zassert_equal(atomic_get(&urc_count), previous_urcs + 1);
	zassert_equal(k_msgq_get(&completions, &done, K_NO_WAIT), -ENOMSG);
	zassert_equal(k_msgq_get(&tx_events, &sent, K_NO_WAIT), -ENOMSG);
	zassert_equal(gt02_at_submit(AT), unavailable);
	inject_text("OK\r\n");
	k_sleep(K_MSEC(60));
	zassert_equal(k_msgq_get(&completions, &done, K_NO_WAIT), -ENOMSG);
	if (CONFIG_AT_TEST_FAULT_CASE == 0) {
		zassert_ok(gt02_at_submit(AT));
		expect_result(AT, GT02_AT_SUCCESS);
		zassert_ok(gt02_at_submit(CSQ));
		expect_result(CSQ, GT02_AT_SUCCESS);
		/* 接收跨期也必须先通知超时，再用本批旧OK恢复，不能把结束行丢掉。 */
		zassert_ok(gt02_at_submit(LATE_READ));
		expect_result(LATE_READ, GT02_AT_TIMEOUT);
		k_sleep(K_MSEC(60));
		zassert_ok(gt02_at_submit(AT));
		expect_result(AT, GT02_AT_SUCCESS);
	} else {
		zassert_equal(gt02_at_submit(AT), -EPIPE);
	}
}

ZTEST_SUITE(gt02_at, NULL, NULL, NULL, NULL, NULL);
```

## src/capability.c
```c
/** @file
 * @brief 验证真实Lierda准备、SIM及数据上下文事件，真实AT核心只注入假I/O。
 */
#include <errno.h>
#include <string.h>
#include <zephyr/kernel.h>
#include <zephyr/sys/atomic.h>
#include <zephyr/ztest.h>

#include "interfaces/gt02_modem.h"
#include "adapters/modem/gt02_modem_lierda.h"

/* 脚本按值入队，字符串均来自长期测试常量；NULL回复表示模拟超时。 */
struct uart_script {
	const char *command;
	const char *reply;
	bool hold;
	size_t reply_length; /* 0表示strlen；非0可注入含NUL的原始正文。 */
};
K_MSGQ_DEFINE(scripts, sizeof(struct uart_script), 8, 4);
K_MSGQ_DEFINE(rx_bytes, sizeof(uint8_t), 1024, 1);
K_MSGQ_DEFINE(events, sizeof(struct gt02_modem_event), 8, 4);
K_SEM_DEFINE(tx_started, 0, 1);
K_SEM_DEFINE(release_tx, 0, 1);
static int receiver_context;
static atomic_t follow_up;
static atomic_t follow_up_result;
static const struct gt02_modem_ops *const modem = &gt02_lierda_ops;

/* 只投递模拟原始字节，不直接调用厂家解析，保留SDK拆包和AT最终回调路径。 */
static void inject_text(const char *text)
{
	for (size_t i = 0; i < strlen(text); ++i) {
		zassert_ok(k_msgq_put(&rx_bytes, &text[i], K_NO_WAIT));
	}
}

/* 假UART每次读取一个字节，按真实接口保留等待超时和实际长度语义。 */
static int fake_read(uint8_t *buffer, size_t capacity, size_t *received, k_timeout_t timeout)
{
	zassert_true(capacity > 0);
	*received = 0;
	if (k_msgq_get(&rx_bytes, buffer, timeout) != 0) {
		return -EAGAIN;
	}
	*received = 1;
	return 0;
}

/* 严格核对脚本中的命令；暂停发送用来制造确定的在途状态，验证并发拒绝。 */
static int fake_write(const uint8_t *buffer, size_t length, size_t *written)
{
	struct uart_script script;

	zassert_ok(k_msgq_get(&scripts, &script, K_NO_WAIT), "unexpected command");
	zassert_equal(length, strlen(script.command) + 2);
	zassert_mem_equal(buffer, script.command, length - 2);
	zassert_mem_equal(buffer + length - 2, "\r\n", 2);
	*written = length;
	if (script.hold) {
		k_sem_give(&tx_started);
		zassert_ok(k_sem_take(&release_tx, K_SECONDS(2)));
	}
	if (script.reply != NULL) {
		size_t reply_length = script.reply_length != 0 ? script.reply_length : strlen(script.reply);

		for (size_t i = 0; i < reply_length; ++i) {
			zassert_ok(k_msgq_put(&rx_bytes, &script.reply[i], K_NO_WAIT));
		}
	}
	return 0;
}

/* 接收者立即复制借用事件；可选再入队一次查询，验证厂家没有持锁通知或残留busy。 */
static void on_event(const struct gt02_modem_event *event, void *user_data)
{
	zassert_false(k_is_in_isr());
	zassert_equal_ptr(user_data, &receiver_context);
	zassert_not_null(event);
	if (event->type == GT02_MODEM_EVENT_QUERY_DONE && atomic_cas(&follow_up, 1, 0)) {
		int ret = modem->query(GT02_MODEM_QUERY_SIM);

		atomic_set(&follow_up_result, ret);
		zassert_ok(ret, "callback re-entry rejected");
	}
	/* 所有测试回调动作完成后才唤醒检查线程，避免下一用例提前改变follow_up。 */
	zassert_ok(k_msgq_put(&events, event, K_NO_WAIT));
}

/* 每次接受操作前准备严格的TX/RX脚本；被拒绝的操作不得消费脚本。 */
static void add_script(const char *command, const char *reply, bool hold)
{
	const struct uart_script script = { .command = command, .reply = reply, .hold = hold };

	zassert_ok(k_msgq_put(&scripts, &script, K_NO_WAIT));
}

/* 按值读取最终事件，错误时必须为UNKNOWN，不允许交付失败事务中曾出现的READY。 */
static void expect_event(enum gt02_modem_event_type type, int error, enum gt02_modem_sim_state sim)
{
	struct gt02_modem_event event;

	zassert_ok(k_msgq_get(&events, &event, K_SECONDS(3)));
	zassert_equal(event.type, type);
	zassert_equal(event.error, error);
	zassert_equal(event.sim, sim);
	if (type == GT02_MODEM_EVENT_QUERY_DONE) {
		zassert_equal(event.query, GT02_MODEM_QUERY_SIM);
	}
}

/* 数据上下文只在成功时有效；空上下文及失败必须保持全零，不能泄漏上次IP。 */
static void expect_context(int error, bool active, const uint8_t ipv4[4])
{
	struct gt02_modem_event event;

	zassert_ok(k_msgq_get(&events, &event, K_SECONDS(12)));
	zassert_equal(event.type, GT02_MODEM_EVENT_QUERY_DONE);
	zassert_equal(event.query, GT02_MODEM_QUERY_DATA_CONTEXT);
	zassert_equal(event.error, error);
	zassert_equal(event.sim, GT02_MODEM_SIM_UNKNOWN);
	zassert_equal(event.signal_rssi, 0);
	zassert_equal(event.registration, 0);
	zassert_equal(event.data_context.active, active);
	zassert_mem_equal(event.data_context.ipv4, ipv4, 4);
}

/* 单次开机覆盖可继续的协议结果，最后注入超时；不访问任何真实电源或GPIO。 */
ZTEST(gt02_capability, test_protocol_ops)
{
	static const struct gt02_at_io_ops io = { .read = fake_read, .write = fake_write };
	static const struct gt02_at_config config = { .profile = &gt02_lierda_at_profile, .io = &io };
	struct gt02_modem_event unused;

	zassert_equal(modem->prepare(), -EACCES);
	zassert_equal(modem->query(GT02_MODEM_QUERY_SIM), -EACCES);
	zassert_equal(modem->query(GT02_MODEM_QUERY_DATA_CONTEXT), -EACCES);
	zassert_equal(modem->activate_data_context(), -EACCES);
	zassert_equal(modem->init(NULL, NULL), -EINVAL);
	zassert_ok(modem->init(on_event, &receiver_context));
	zassert_equal(modem->init(on_event, NULL), -EALREADY);
	zassert_equal(modem->query((enum gt02_modem_query)99), -ENOTSUP);
	/* AT尚未初始化时立即拒绝，厂家必须撤销busy，且没有完成事件。 */
	zassert_equal(modem->prepare(), -EACCES);
	zassert_equal(modem->query(GT02_MODEM_QUERY_SIM), -EACCES);
	zassert_equal(k_msgq_get(&events, &unused, K_NO_WAIT), -ENOMSG);
	zassert_ok(gt02_at_init(&config));
	/* 每次启动通知独立于操作完成；服务负责按当前阶段过滤重复RDY。 */
	inject_text("RDY\r\nRDY\r\n");
	expect_event(GT02_MODEM_EVENT_STARTUP_READY, 0, GT02_MODEM_SIM_UNKNOWN);
	expect_event(GT02_MODEM_EVENT_STARTUP_READY, 0, GT02_MODEM_SIM_UNKNOWN);

	add_script("AT", "OK\r\n", true);
	add_script("ATE0", "OK\r\n", false);
	zassert_ok(modem->prepare());
	zassert_ok(k_sem_take(&tx_started, K_SECONDS(2)));
	zassert_equal(modem->prepare(), -EBUSY);
	zassert_equal(modem->query(GT02_MODEM_QUERY_SIM), -EBUSY);
	zassert_equal(modem->activate_data_context(), -EBUSY);
	k_sem_give(&release_tx);
	expect_event(GT02_MODEM_EVENT_PREPARE_DONE, 0, GT02_MODEM_SIM_UNKNOWN);
	/* 任一步ERROR都只报告一个失败，不自动重试或继续后续准备命令。 */
	add_script("AT", "ERROR\r\n", false);
	zassert_ok(modem->prepare());
	expect_event(GT02_MODEM_EVENT_PREPARE_DONE, -EIO, GT02_MODEM_SIM_UNKNOWN);
	add_script("AT", "OK\r\n", false);
	add_script("ATE0", "ERROR\r\n", false);
	zassert_ok(modem->prepare());
	expect_event(GT02_MODEM_EVENT_PREPARE_DONE, -EIO, GT02_MODEM_SIM_UNKNOWN);

	/* 激活是独立异步操作；等待期间拒绝其他操作，最终结果不冒充IP查询结果。 */
	add_script("AT+QIACT=1", "OK\r\n", true);
	zassert_ok(modem->activate_data_context());
	zassert_ok(k_sem_take(&tx_started, K_SECONDS(2)));
	zassert_equal(modem->activate_data_context(), -EBUSY);
	zassert_equal(modem->query(GT02_MODEM_QUERY_DATA_CONTEXT), -EBUSY);
	zassert_equal(modem->prepare(), -EBUSY);
	k_sem_give(&release_tx);
	expect_event(GT02_MODEM_EVENT_ACTIVATE_DONE, 0, GT02_MODEM_SIM_UNKNOWN);
	add_script("AT+QIACT=1", "ERROR\r\n", false);
	zassert_ok(modem->activate_data_context());
	expect_event(GT02_MODEM_EVENT_ACTIVATE_DONE, -EIO, GT02_MODEM_SIM_UNKNOWN);

	const struct {
		const char *reply;
		int error;
		enum gt02_modem_sim_state sim;
	} cases[] = {
		{ "+CPIN: READY\r\nOK\r\n", 0, GT02_MODEM_SIM_READY },
		{ "+CPIN: SIM PIN\r\nOK\r\n", 0, GT02_MODEM_SIM_PIN_REQUIRED },
		{ "+CPIN: SIM PUK \t\r\nOK\r\n", 0, GT02_MODEM_SIM_PUK_REQUIRED },
		{ "+CPIN: NOT READY\r\nOK\r\n", 0, GT02_MODEM_SIM_NOT_READY },
		{ "+CPIN: invalid\r\nOK\r\n", -EBADMSG, GT02_MODEM_SIM_UNKNOWN },
		{ "+CPIN: READY\r\nERROR\r\n", -EIO, GT02_MODEM_SIM_UNKNOWN },
		{ "+CME ERROR: 10\r\n", -EIO, GT02_MODEM_SIM_UNKNOWN },
		{ "OK\r\n", -EIO, GT02_MODEM_SIM_UNKNOWN },
	};

	for (size_t i = 0; i < ARRAY_SIZE(cases); ++i) {
		add_script("AT+CPIN?", cases[i].reply, i == 0);
		zassert_ok(modem->query(GT02_MODEM_QUERY_SIM));
		if (i == 0) {
			zassert_ok(k_sem_take(&tx_started, K_SECONDS(2)));
			zassert_equal(modem->query(GT02_MODEM_QUERY_SIM), -EBUSY);
			zassert_equal(modem->prepare(), -EBUSY);
			k_sem_give(&release_tx);
		}
		expect_event(GT02_MODEM_EVENT_QUERY_DONE, cases[i].error, cases[i].sim);
	}

	add_script("AT+CPIN?", "+CPIN: READY\r\nOK\r\n", false);
	add_script("AT+CPIN?", "+CPIN: SIM PIN\r\nOK\r\n", false);
	atomic_set(&follow_up, 1);
	zassert_ok(modem->query(GT02_MODEM_QUERY_SIM));
	expect_event(GT02_MODEM_EVENT_QUERY_DONE, 0, GT02_MODEM_SIM_READY);
	expect_event(GT02_MODEM_EVENT_QUERY_DONE, 0, GT02_MODEM_SIM_PIN_REQUIRED);
	zassert_equal(atomic_get(&follow_up_result), 0);

	const uint8_t zero_ip[4] = {0};
	const struct {
		const char *reply;
		int error;
		bool active;
		uint8_t ipv4[4];
	} contexts[] = {
		{ "+QIACT: 1,1,1,\"10.20.30.40\"\r\nOK\r\n", 0, true, {10, 20, 30, 40} },
		{ "OK\r\n", 0, false, {0} },
		{ "+QIACT: 2,1,1,\"10.0.0.2\"\r\nOK\r\n", 0, false, {0} },
		{ "+QIACT: 2,1,2,\"2001:db8::2\"\r\n+QIACT: 1,1,1,\"10.0.0.1\"\r\n"
		  "+QIACT: 3,1,1,\"10.0.0.3\"\r\nOK\r\n", 0, true, {10, 0, 0, 1} },
		{ "+QIACT: 1,1,1,\"0.0.0.0\"\r\nOK\r\n", 0, true, {0} },
		{ "+QIACT: 1,0,1,\"\"\r\nOK\r\n", 0, false, {0} },
		{ "+QIACT: 1,0,1,\"10.20.30.40\"\r\nOK\r\n", 0, false, {0} },
		{ "+QIACT: 1,1,2,\"2001:db8::1\"\r\nOK\r\n", -ENOTSUP, false, {0} },
		{ "+QIACT: 1,bad\r\nOK\r\n", -EBADMSG, false, {0} },
		{ "+QIACT: 1,1,1,\"256.1.2.3\"\r\nOK\r\n", -EBADMSG, false, {0} },
		{ "+QIACT: 1,1,1,\"1.2.3\"\r\nOK\r\n", -EBADMSG, false, {0} },
		{ "+QIACT: 1,1,1,\"1.2.3.-4\"\r\nOK\r\n", -EBADMSG, false, {0} },
		{ "+QIACT: 1,1,1,\"1.2.3.4\"junk\r\nOK\r\n", -EBADMSG, false, {0} },
		{ "+QIACT: 1,0,1,missing_quotes\r\nOK\r\n", -EBADMSG, false, {0} },
		{ "+QIACT: 1,1,1,\"10.0.0.1\"\r\n+QIACT: 1,1,1,\"10.0.0.2\"\r\nOK\r\n",
		  -EBADMSG, false, {0} },
		{ "+QIACT: 1,1,1,\"10.20.30.40\"\r\nERROR\r\n", -EIO, false, {0} },
	};

	for (size_t i = 0; i < ARRAY_SIZE(contexts); ++i) {
		add_script("AT+QIACT?", contexts[i].reply, i == 0);
		zassert_ok(modem->query(GT02_MODEM_QUERY_DATA_CONTEXT));
		if (i == 0) {
			zassert_ok(k_sem_take(&tx_started, K_SECONDS(2)));
			zassert_equal(modem->query(GT02_MODEM_QUERY_DATA_CONTEXT), -EBUSY);
			zassert_equal(modem->query(GT02_MODEM_QUERY_SIM), -EBUSY);
			k_sem_give(&release_tx);
		}
		expect_context(contexts[i].error, contexts[i].active, contexts[i].ipv4);
	}

	static const char nul_reply[] = "+QIACT: 1,1,1,\"10.0.\0.1\"\r\nOK\r\n";
	const struct uart_script nul_script = {
		.command = "AT+QIACT?", .reply = nul_reply, .reply_length = sizeof(nul_reply) - 1,
	};

	zassert_ok(k_msgq_put(&scripts, &nul_script, K_NO_WAIT));
	zassert_ok(modem->query(GT02_MODEM_QUERY_DATA_CONTEXT));
	expect_context(-EBADMSG, false, zero_ip);

	add_script("AT+QIACT?", NULL, false);
	zassert_ok(modem->query(GT02_MODEM_QUERY_DATA_CONTEXT));
	expect_context(-ETIMEDOUT, false, zero_ip);
	zassert_equal(modem->query(GT02_MODEM_QUERY_SIM), -EAGAIN);
	zassert_equal(modem->query(GT02_MODEM_QUERY_DATA_CONTEXT), -EAGAIN);
	zassert_equal(modem->prepare(), -EAGAIN);
	zassert_equal(modem->activate_data_context(), -EAGAIN);
	k_sleep(K_MSEC(40));
	zassert_equal(k_msgq_get(&events, &unused, K_NO_WAIT), -ENOMSG);
	zassert_equal(k_msgq_num_used_get(&scripts), 0);
	/* 旧失败结束行只解除隔离，不重复通知；厂家busy应已释放，恢复后可再次查询。 */
	inject_text("+CMS ERROR: 500\r\n");
	k_sleep(K_MSEC(60));
	zassert_equal(k_msgq_get(&events, &unused, K_NO_WAIT), -ENOMSG);
	add_script("AT+CPIN?", "+CPIN: READY\r\nOK\r\n", false);
	zassert_ok(modem->query(GT02_MODEM_QUERY_SIM));
	expect_event(GT02_MODEM_EVENT_QUERY_DONE, 0, GT02_MODEM_SIM_READY);
}

ZTEST_SUITE(gt02_capability, NULL, NULL, NULL, NULL, NULL);
```

## src/network.c
```c
/** @file
 * @brief 运行真实周期服务与厂家/AT解析；用假电源和字节流验证跨轮结果与故障边界。
 */
#include <errno.h>
#include <string.h>
#include <zephyr/kernel.h>
#include <zephyr/sys/atomic.h>
#include <zephyr/ztest.h>

#include "services/network/gt02_network_service.h"
#include "adapters/modem/gt02_modem_lierda.h"

K_MSGQ_DEFINE(fake_rx, sizeof(uint8_t), 1024, 1);
K_SEM_DEFINE(round_held, 0, 1);
K_SEM_DEFINE(release_round, 0, 1);
K_SEM_DEFINE(operation_pending, 0, 1);
K_SEM_DEFINE(power_pending, 0, 1);
K_SEM_DEFINE(release_power, 0, 1);
static atomic_t power_count;
static atomic_t powered;
static atomic_t tx_count;
static atomic_t prepare_count;
static atomic_t query_count;
static atomic_t activation_count;
static atomic_t activation_succeeded;
static atomic_t ip_query_count;
static unsigned int round_number; /* 实际UART场景由AT线程独占，替代后端场景由服务线程独占。 */
static unsigned int query_step;
static int64_t prepare_retry_at_ms;
static gt02_modem_event_cb_t inline_callback;
static void *inline_context;

/* 注入原始串口字节，保证真实SDK解析器和厂家回调均参与测试。 */
static void inject_text(const char *text)
{
	for (size_t i = 0; i < strlen(text); ++i) {
		zassert_ok(k_msgq_put(&fake_rx, &text[i], K_NO_WAIT));
	}
}

/* 启动通知可以早于上电返回；慢上电场景暂停返回，验证业务线程仍能处理故障。 */
static int fake_power_on(void)
{
	zassert_equal(atomic_inc(&power_count), 0);
	atomic_set(&powered, 1);
	if (CONFIG_AT_TEST_NETWORK_CASE >= 7) {
		const struct gt02_modem_event event = { .type = GT02_MODEM_EVENT_STARTUP_READY };

		inline_callback(&event, inline_context);
		if (CONFIG_AT_TEST_NETWORK_CASE == 17 || CONFIG_AT_TEST_NETWORK_CASE == 18) {
			k_sem_give(&power_pending);
			zassert_ok(k_sem_take(&release_power, K_SECONDS(2)));
		}
	} else if (CONFIG_AT_TEST_NETWORK_CASE != 4) {
		inject_text(CONFIG_AT_TEST_NETWORK_CASE == 5 ? "RDY\r\nRDY\r\nRDY\r\n" :
			    "RDY\r\n");
		k_sleep(K_MSEC(40));
		zassert_equal(atomic_get(&tx_count), 0, "AT sent before power_on returned");
	}
	return 0;
}

/* 初始未上电返回-EPIPE；上电后每次读一个字节，保留SDK的分片拼行路径。 */
static int fake_read(uint8_t *buffer, size_t capacity, size_t *received, k_timeout_t timeout)
{
	zassert_true(capacity > 0);
	*received = 0;
	if (!atomic_get(&powered)) {
		return -EPIPE;
	}
	if (k_msgq_get(&fake_rx, buffer, timeout) != 0) {
		return -EAGAIN;
	}
	*received = 1;
	return 0;
}

/* 核对握手、注册后的一次激活及四项查询；暂停后续轮次，观察一致快照。 */
static int fake_write(const uint8_t *buffer, size_t length, size_t *written)
{
	static const char *const commands[] = { "AT+CPIN?", "AT+CSQ", "AT+CEREG?", "AT+QIACT?" };
	unsigned int index = (unsigned int)atomic_inc(&tx_count);

	*written = length;
	if (length == strlen("AT+QIACT=1\r\n") && memcmp(buffer, "AT+QIACT=1\r\n", length) == 0) {
		zassert_equal(query_step, 3, "PDP activated before successful registration");
		zassert_equal(atomic_inc(&activation_count), 0, "PDP activated twice in one power session");
		atomic_set(&activation_succeeded, 1);
		inject_text("OK\r\n");
		return 0;
	}
	const char *expected = index < 2 ? (index == 0 ? "AT" : "ATE0") : commands[query_step];

	zassert_equal(length, strlen(expected) + 2);
	zassert_mem_equal(buffer, expected, length - 2);
	zassert_mem_equal(buffer + length - 2, "\r\n", 2);
	if (CONFIG_AT_TEST_NETWORK_CASE == 5) {
		inject_text("RDY\r\n");
	}
	if (index < 2) {
		inject_text("OK\r\n");
		return 0;
	}
	if (query_step == 0) {
		++round_number;
		if (CONFIG_AT_TEST_NETWORK_CASE <= 3 && round_number >= 2 && round_number <= 3) {
			k_sem_give(&round_held);
			zassert_ok(k_sem_take(&release_round, K_SECONDS(2)));
		}
		if (CONFIG_AT_TEST_NETWORK_CASE != 6 || index != 2) {
			inject_text("+CPIN: READY\r\nOK\r\n");
		} else {
			/* 第一条SIM故意超时，下轮仍从SIM重新开始。 */
			return 0;
		}
	} else if (query_step == 1) {
		/* 99和0均是可报告的信号值，不能单凭强度未知/弱就拒绝数据就绪。 */
		inject_text(round_number == 1 ? "+CSQ: 99,99\r\nOK\r\n" : "+CSQ: 0,0\r\nOK\r\n");
	} else if (query_step == 2) {
		if (CONFIG_AT_TEST_NETWORK_CASE == 0 && round_number == 2) {
			inject_text("+CEREG: 0,2\r\nOK\r\n");
			query_step = 0;
			return 0;
		}
		inject_text("+CEREG: 0,1\r\nOK\r\n");
	} else if (query_step == 3) {
		zassert_equal(atomic_get(&activation_succeeded), 1, "IP queried before activation succeeded");
		atomic_inc(&ip_query_count);
		if (CONFIG_AT_TEST_NETWORK_CASE == 1 && round_number == 1) {
			inject_text("OK\r\n");
		} else if (CONFIG_AT_TEST_NETWORK_CASE == 2 && round_number == 1) {
			inject_text("+QIACT: 1,1,1,\"0.0.0.0\"\r\nOK\r\n");
		} else if (CONFIG_AT_TEST_NETWORK_CASE == 3 && round_number == 1) {
			inject_text("+QIACT: 1,1,1,\"10.22.0.1\"\r\nERROR\r\n");
		} else {
			inject_text("+QIACT: 1,1,1,\"10.22.0.1\"\r\nOK\r\n");
		}
	}
	query_step = (query_step + 1) % ARRAY_SIZE(commands);
	return 0;
}

/* 替代后端只绑定长期事件出口，验证服务不依赖Lierda或AT实现。 */
static int inline_init(gt02_modem_event_cb_t callback, void *context)
{
	inline_callback = callback;
	inline_context = context;
	return 0;
}

/* 通常同步交付准备事件；慢准备场景只登记已接受，稍后由测试发送最终结果。 */
static int inline_prepare(void)
{
	int attempt = atomic_inc(&prepare_count);
	int mode = CONFIG_AT_TEST_NETWORK_CASE;

	if ((mode == 12 || mode == 13) && attempt == 0) {
		prepare_retry_at_ms = k_uptime_get() + 30;
		if (mode == 12) {
			return -EAGAIN; /* 本次未接受，不应等待完成事件。 */
		}
		const struct gt02_modem_event timeout = {
			.type = GT02_MODEM_EVENT_PREPARE_DONE, .error = -ETIMEDOUT,
		};

		inline_callback(&timeout, inline_context);
		return 0;
	}
	if (mode == 12 || mode == 13) {
		zassert_true(k_uptime_get() >= prepare_retry_at_ms, "prepare retried too early");
	}
	if (mode == 14) {
		const struct gt02_modem_event ready = { .type = GT02_MODEM_EVENT_STARTUP_READY };

		/* 同步后端在服务取事件前填满队列，不能静默丢失完成通知。 */
		for (int i = 0; i < 6; ++i) {
			inline_callback(&ready, inline_context);
		}
	}
	if (CONFIG_AT_TEST_NETWORK_CASE == 10) {
		k_sem_give(&operation_pending);
		return 0;
	}
	const struct gt02_modem_event event = {
		.type = CONFIG_AT_TEST_NETWORK_CASE == 8 ? GT02_MODEM_EVENT_QUERY_DONE :
			GT02_MODEM_EVENT_PREPARE_DONE,
		.error = mode == 15 ? -EIO : 0,
	};

	inline_callback(&event, inline_context);
	return 0;
}

/* 模拟激活接受、拒绝、失败或延迟完成；成功前不得查询IP，后续轮次不应重复成功激活。 */
static int inline_activate(void)
{
	int attempt = atomic_inc(&activation_count);
	int mode = CONFIG_AT_TEST_NETWORK_CASE;
	struct gt02_modem_event event = { .type = GT02_MODEM_EVENT_ACTIVATE_DONE };

	zassert_equal(atomic_get(&activation_succeeded), 0, "PDP activated again after success");
	if (mode == 19 || mode == 25) {
		k_sem_give(&operation_pending);
		return 0;
	}
	if (mode == 21 && attempt == 0) {
		return -EAGAIN;
	}
	if ((mode == 20 || mode == 24) && attempt == 0) {
		event.error = mode == 20 ? -EIO : -ETIMEDOUT;
	} else if (mode == 23) {
		event.type = GT02_MODEM_EVENT_QUERY_DONE;
		event.query = GT02_MODEM_QUERY_DATA_CONTEXT;
	} else {
		atomic_set(&activation_succeeded, 1);
	}
	inline_callback(&event, inline_context);
	return 0;
}

/* 慢查询场景保留一项在途操作；由测试稍后完成或发故障通知，验证服务没有重复计时。 */
static int inline_query(enum gt02_modem_query query)
{
	struct gt02_modem_event event = {
		.type = GT02_MODEM_EVENT_QUERY_DONE, .query = query,
		.sim = GT02_MODEM_SIM_READY, .signal_rssi = 99, .registration = 1,
		.data_context = { .active = true, .ipv4 = { 10, 22, 0, 1 } },
	};

	atomic_inc(&query_count);
	if (query == GT02_MODEM_QUERY_DATA_CONTEXT) {
		zassert_equal(atomic_get(&activation_succeeded), 1, "IP queried before activation completed");
		atomic_inc(&ip_query_count);
	}
	if (query == GT02_MODEM_QUERY_SIM) {
		++round_number;
		if (CONFIG_AT_TEST_NETWORK_CASE == 16) {
			if (round_number == 1) {
				event.sim = GT02_MODEM_SIM_NOT_READY;
			} else if (round_number == 2) {
				zassert_equal(atomic_get(&query_count), 2,
					      "queries continued after SIM was not ready");
			}
		}
	}
	if (query == GT02_MODEM_QUERY_LTE_REGISTRATION && CONFIG_AT_TEST_NETWORK_CASE == 22) {
		if (round_number == 1) {
			event.registration = 2;
		} else if (round_number == 2) {
			zassert_equal(atomic_get(&activation_count), 0, "PDP activated before registration");
		}
	}
	if (query == GT02_MODEM_QUERY_SIGNAL &&
	    ((CONFIG_AT_TEST_NETWORK_CASE == 7 && round_number == 2) ||
	     CONFIG_AT_TEST_NETWORK_CASE == 11)) {
		k_sem_give(&operation_pending);
		return 0;
	}
	if (CONFIG_AT_TEST_NETWORK_CASE == 9 && query == GT02_MODEM_QUERY_SIM) {
		event.query = GT02_MODEM_QUERY_SIGNAL; /* 查询结果不属于当前在途项。 */
	}
	inline_callback(&event, inline_context);
	return 0;
}

/* 只等待公开可观察结论，不读取服务内部变量；checked_at区分前后轮次。 */
static struct gt02_network_status wait_status(enum gt02_network_state state, int error,
					    int64_t after_ms)
{
	struct gt02_network_status snapshot;
	int64_t deadline = k_uptime_get() + 5000;

	do {
		zassert_ok(gt02_network_service_get_status(&snapshot));
		if (snapshot.state == state && snapshot.error == error &&
		    snapshot.checked_at_ms >= after_ms) {
			return snapshot;
		}
		k_sleep(K_MSEC(5));
	} while (k_uptime_get() < deadline);
	zassert_unreachable("state=%d error=%d; expected state=%d error=%d",
			    snapshot.state, snapshot.error, state, error);
	return snapshot;
}

/* 单次开机验证注册、激活与IP确认；异常场景不隐式重新上电、配置APN或建立TCP。 */
ZTEST(gt02_network, test_periodic_readiness)
{
	static const struct gt02_at_io_ops io = { .read = fake_read, .write = fake_write };
	static const struct gt02_at_config at = { .profile = &gt02_lierda_at_profile, .io = &io };
	static const struct gt02_modem_power_ops power = { .power_on = fake_power_on };
	static const struct gt02_modem_ops immediate = {
		.init = inline_init, .prepare = inline_prepare, .query = inline_query,
		.activate_data_context = inline_activate,
	};
	struct gt02_network_config config = {
		.power = &power, .modem = CONFIG_AT_TEST_NETWORK_CASE >= 7 ? &immediate : &gt02_lierda_ops,
		.startup_timeout_ms = 200,
		.retry_interval_ms = 30, .check_interval_ms = 50,
		.result_valid_ms = CONFIG_AT_TEST_NETWORK_CASE == 7 ? 150 : 1000,
	};
	struct gt02_network_status snapshot;
	int mode = CONFIG_AT_TEST_NETWORK_CASE;

	zassert_equal(gt02_network_service_get_status(NULL), -EINVAL);
	zassert_ok(gt02_network_service_get_status(&snapshot));
	zassert_equal(snapshot.state, GT02_NETWORK_STOPPED);
	zassert_equal(gt02_network_service_start(NULL), -EINVAL);
	config.result_valid_ms = config.check_interval_ms;
	zassert_equal(gt02_network_service_start(&config), -EINVAL);
	config.result_valid_ms = mode == 7 ? 150 : 1000;
	if (mode < 7) {
		zassert_ok(gt02_at_init(&at));
	}
	zassert_ok(gt02_network_service_start(&config));
	zassert_equal(gt02_network_service_start(&config), -EALREADY);
	config.modem = NULL; /* 服务必须已复制配置，不能继续借用调用栈。 */

	if (mode == 19 || mode == 25) {
		zassert_ok(k_sem_take(&operation_pending, K_SECONDS(1)));
		k_sleep(K_MSEC(80));
		zassert_ok(gt02_network_service_get_status(&snapshot));
		zassert_not_equal(snapshot.state, GT02_NETWORK_DATA_READY);
		zassert_equal(atomic_get(&ip_query_count), 0);
		if (mode == 25) {
			gt02_network_service_notify_at_fault(-EIO);
			wait_status(GT02_NETWORK_FAULT, -EIO, 0);
		}
		const struct gt02_modem_event done = { .type = GT02_MODEM_EVENT_ACTIVATE_DONE };

		atomic_set(&activation_succeeded, 1);
		inline_callback(&done, inline_context);
		if (mode == 19) {
			wait_status(GT02_NETWORK_DATA_READY, 0, 0);
			zassert_equal(atomic_get(&activation_count), 1);
		} else {
			k_sleep(K_MSEC(80));
			zassert_ok(gt02_network_service_get_status(&snapshot));
			zassert_equal(snapshot.state, GT02_NETWORK_FAULT);
			zassert_equal(atomic_get(&ip_query_count), 0);
		}
	} else if (mode == 20 || mode == 21 || mode == 24) {
		int error = mode == 20 ? -EIO : (mode == 21 ? -EAGAIN : -ETIMEDOUT);

		snapshot = wait_status(GT02_NETWORK_NOT_READY, error, 0);
		zassert_equal(snapshot.query, GT02_MODEM_QUERY_DATA_CONTEXT);
		zassert_false(snapshot.data_context.active);
		zassert_equal(atomic_get(&ip_query_count), 0);
		wait_status(GT02_NETWORK_DATA_READY, 0, snapshot.checked_at_ms + 1);
		zassert_equal(atomic_get(&activation_count), 2);
	} else if (mode == 22) {
		snapshot = wait_status(GT02_NETWORK_NOT_READY, 0, 0);
		zassert_equal(snapshot.query, GT02_MODEM_QUERY_LTE_REGISTRATION);
		zassert_equal(atomic_get(&activation_count), 0);
		wait_status(GT02_NETWORK_DATA_READY, 0, snapshot.checked_at_ms + 1);
		zassert_equal(atomic_get(&activation_count), 1);
	} else if (mode == 23) {
		wait_status(GT02_NETWORK_FAULT, -EBADMSG, 0);
		zassert_equal(atomic_get(&ip_query_count), 0);
	} else if (mode == 17 || mode == 18) {
		/* 电源操作尚未返回，业务线程也必须能发布故障；迟到完成不得开始AT准备。 */
		zassert_ok(k_sem_take(&power_pending, K_SECONDS(1)));
		if (mode == 17) {
			gt02_network_service_notify_at_fault(-EIO);
		} else {
			const struct gt02_modem_event ready = { .type = GT02_MODEM_EVENT_STARTUP_READY };

			for (int i = 0; i < 6; ++i) {
				inline_callback(&ready, inline_context);
			}
		}
		wait_status(GT02_NETWORK_FAULT, mode == 17 ? -EIO : -ENOBUFS, 0);
		zassert_equal(atomic_get(&prepare_count), 0);
		k_sem_give(&release_power);
		k_sleep(K_MSEC(100));
		zassert_ok(gt02_network_service_get_status(&snapshot));
		zassert_equal(snapshot.state, GT02_NETWORK_FAULT);
		zassert_equal(atomic_get(&prepare_count), 0);
		zassert_equal(atomic_get(&query_count), 0);
	} else if (mode == 4) {
		snapshot = wait_status(GT02_NETWORK_FAULT, -ETIMEDOUT, 0);
		int before = atomic_get(&tx_count);

		zassert_equal(before, 0);
		inject_text("RDY\r\n");
		k_sleep(K_MSEC(80));
		zassert_ok(gt02_network_service_get_status(&snapshot));
		zassert_equal(snapshot.state, GT02_NETWORK_FAULT);
		zassert_equal(atomic_get(&tx_count), before);
	} else if (mode == 6) {
		snapshot = wait_status(GT02_NETWORK_NOT_READY, -ETIMEDOUT, 0);
		wait_status(GT02_NETWORK_NOT_READY, -EAGAIN, snapshot.checked_at_ms);
		zassert_equal(atomic_get(&tx_count), 3, "retry sent before old transaction ended");
		inject_text("+CPIN: READY\r\nOK\r\n");
		snapshot = wait_status(GT02_NETWORK_DATA_READY, 0, snapshot.checked_at_ms + 1);
		zassert_true(snapshot.data_context.active);
	} else if (mode == 7) {
		snapshot = wait_status(GT02_NETWORK_DATA_READY, 0, 0);
		zassert_ok(k_sem_take(&operation_pending, K_SECONDS(1)));
		wait_status(GT02_NETWORK_NOT_READY, -ESTALE, snapshot.checked_at_ms);
		int before = atomic_get(&query_count);

		/* 超过原测试500ms服务保护；不能故障或启动第二次查询，旧快照仍应过期。 */
		k_sleep(K_MSEC(600));
		struct gt02_network_status waiting;

		zassert_ok(gt02_network_service_get_status(&waiting));
		zassert_equal(waiting.state, GT02_NETWORK_NOT_READY);
		zassert_equal(waiting.error, -ESTALE);
		zassert_equal(atomic_get(&query_count), before);
		const struct gt02_modem_event late = {
			.type = GT02_MODEM_EVENT_QUERY_DONE, .query = GT02_MODEM_QUERY_SIGNAL,
			.signal_rssi = 18,
		};

		inline_callback(&late, inline_context);
		snapshot = wait_status(GT02_NETWORK_DATA_READY, 0, snapshot.checked_at_ms + 1);
		zassert_equal(snapshot.signal_rssi, 18);
		zassert_equal(atomic_get(&tx_count), 0);
	} else if (mode == 10) {
		zassert_ok(k_sem_take(&operation_pending, K_SECONDS(1)));
		k_sleep(K_MSEC(600)); /* RDY已到达，旧的200ms启动期限不能再作用于准备阶段。 */
		zassert_ok(gt02_network_service_get_status(&snapshot));
		zassert_equal(snapshot.state, GT02_NETWORK_STARTING);
		zassert_equal(atomic_get(&prepare_count), 1);
		zassert_equal(atomic_get(&query_count), 0);
		const struct gt02_modem_event done = { .type = GT02_MODEM_EVENT_PREPARE_DONE };

		inline_callback(&done, inline_context);
		wait_status(GT02_NETWORK_DATA_READY, 0, 0);
	} else if (mode == 11) {
		zassert_ok(k_sem_take(&operation_pending, K_SECONDS(1)));
		/* 即使服务只等操作事件，独立AT故障也必须及时唤醒它。 */
		gt02_network_service_notify_at_fault(-EIO);
		wait_status(GT02_NETWORK_FAULT, -EIO, 0);
		const struct gt02_modem_event late = {
			.type = GT02_MODEM_EVENT_QUERY_DONE, .query = GT02_MODEM_QUERY_SIGNAL,
		};

		inline_callback(&late, inline_context);
		k_sleep(K_MSEC(60));
		zassert_ok(gt02_network_service_get_status(&snapshot));
		zassert_equal(snapshot.state, GT02_NETWORK_FAULT);
		zassert_equal(snapshot.error, -EIO);
	} else if (mode == 12 || mode == 13) {
		wait_status(GT02_NETWORK_DATA_READY, 0, 0);
		zassert_equal(atomic_get(&prepare_count), 2);
	} else if (mode == 14 || mode == 15) {
		wait_status(GT02_NETWORK_FAULT, mode == 14 ? -ENOBUFS : -EIO, 0);
		k_sleep(K_MSEC(100));
		zassert_equal(atomic_get(&prepare_count), 1);
		zassert_equal(atomic_get(&query_count), 0);
	} else if (mode == 16) {
		snapshot = wait_status(GT02_NETWORK_NOT_READY, 0, 0);
		zassert_equal(snapshot.query, GT02_MODEM_QUERY_SIM);
		zassert_equal(snapshot.sim, GT02_MODEM_SIM_NOT_READY);
		wait_status(GT02_NETWORK_DATA_READY, 0, snapshot.checked_at_ms + 1);
	} else if (mode == 8 || mode == 9) {
		/* 错阶段/错查询必须故障；随后正确的迟到完成也不能重新启动流程。 */
		wait_status(GT02_NETWORK_FAULT, -EBADMSG, 0);
		const struct gt02_modem_event late = {
			.type = mode == 8 ? GT02_MODEM_EVENT_PREPARE_DONE : GT02_MODEM_EVENT_QUERY_DONE,
			.query = GT02_MODEM_QUERY_SIM, .sim = GT02_MODEM_SIM_READY,
		};

		inline_callback(&late, inline_context);
		k_sleep(K_MSEC(60));
		zassert_ok(gt02_network_service_get_status(&snapshot));
		zassert_equal(snapshot.state, GT02_NETWORK_FAULT);
		zassert_equal(snapshot.error, -EBADMSG);
		zassert_equal(atomic_get(&tx_count), 0);
	} else if (mode == 5) {
		snapshot = wait_status(GT02_NETWORK_DATA_READY, 0, 0);
		zassert_equal(snapshot.signal_rssi, 99);
		zassert_true(snapshot.data_context.active);
		zassert_equal(atomic_get(&tx_count), 7);
	} else {
		zassert_ok(k_sem_take(&round_held, K_SECONDS(4)));
		zassert_ok(gt02_network_service_get_status(&snapshot));
		zassert_equal(snapshot.state, mode == 0 ? GT02_NETWORK_DATA_READY : GT02_NETWORK_NOT_READY);
		zassert_equal(snapshot.error, mode == 3 ? -EIO : 0);
		if (mode == 3) {
			zassert_equal(snapshot.sim, GT02_MODEM_SIM_UNKNOWN);
			zassert_equal(snapshot.registration, 0);
			zassert_false(snapshot.data_context.active);
		}
		int64_t first_time = snapshot.checked_at_ms;
		k_sem_give(&release_round);
		zassert_ok(k_sem_take(&round_held, K_SECONDS(4)));
		zassert_ok(gt02_network_service_get_status(&snapshot));
		zassert_true(snapshot.checked_at_ms > first_time);
		zassert_equal(snapshot.state, mode == 0 ? GT02_NETWORK_NOT_READY : GT02_NETWORK_DATA_READY);
		zassert_equal(snapshot.error, 0);
		if (mode == 0) {
			zassert_equal(snapshot.registration, 2);
		}
		int64_t second_time = snapshot.checked_at_ms;
		k_sem_give(&release_round);
		snapshot = wait_status(GT02_NETWORK_DATA_READY, 0, second_time + 1);
		zassert_true(snapshot.data_context.active);
		zassert_equal(snapshot.signal_rssi, 0);
	}
	zassert_equal(atomic_get(&power_count), 1);
}

ZTEST_SUITE(gt02_network, NULL, NULL, NULL, NULL, NULL);
```
