## boards/others/gt02/Kconfig.gt02
```kconfig
# GT02板级Kconfig入口：负责把板目标映射到正确的SoC。

# SPDX-License-Identifier: Apache-2.0

# BOARD_GT02由Zephyr根据board.yml自动生成并在选择GT02时置为y。
config BOARD_GT02
	# 当目标限定符是nrf52840时，选择nRF52840 QIAA封装的SoC定义。
	# 这里只选择SoC，不在板级Kconfig中开启BLE、日志等应用功能。
	select SOC_NRF52840_QIAA if BOARD_GT02_NRF52840
```

## boards/others/gt02/board.yml
```yaml
# board.yml描述“这块板是谁，以及它包含哪个SoC”。
# 它用于Zephyr硬件模型发现，不负责配置引脚或启用应用功能。
board:
  # 板的机器可读名称，也是构建目标gt02/nrf52840的第一部分。
  name: gt02
  # 面向开发者显示的完整板名。
  full_name: GT02 nRF52840
  # 当前是工程私有板，没有向Zephyr注册厂商前缀，因此使用others。
  vendor: others
  # 列出该物理板可使用的SoC或SoC变体。
  socs:
    # 构建目标gt02/nrf52840的第二部分，选择Zephyr已有的nRF52840 SoC。
    - name: nrf52840
```

## boards/others/gt02/gt02_nrf52840_defconfig
```kconfig
# SPDX-License-Identifier: Apache-2.0

# 启用Cortex-M内存保护单元，供Zephyr实现栈保护等内核安全能力。
CONFIG_ARM_MPU=y
# 利用MPU检测线程栈越界；这是板级基础保护，不属于某个产品功能。
CONFIG_HW_STACK_PROTECTION=y
# GPIO是GT02最小板级启动所必需的驱动能力。
CONFIG_GPIO=y
```

## tests/modem_at/testcase.yaml
```yaml
common:
  platform_allow: qemu_cortex_m3
  tags:
    - modem
    - at
  timeout: 30
tests:
  gt02.modem_at.session_recovery:
    extra_configs: [CONFIG_AT_TEST_RECOVERY=y, CONFIG_AT_TEST_RECOVERY_CASE=0]
  gt02.modem_at.service_recovery:
    extra_configs: [CONFIG_AT_TEST_RECOVERY=y, CONFIG_AT_TEST_RECOVERY_CASE=1]
  gt02.modem_at.recovery_off_failure:
    extra_configs: [CONFIG_AT_TEST_RECOVERY=y, CONFIG_AT_TEST_RECOVERY_CASE=2]
  gt02.modem_at.recovery_missing_ready:
    extra_configs: [CONFIG_AT_TEST_RECOVERY=y, CONFIG_AT_TEST_RECOVERY_CASE=3]
  gt02.modem_at.recovery_prepare_error:
    extra_configs: [CONFIG_AT_TEST_RECOVERY=y, CONFIG_AT_TEST_RECOVERY_CASE=4]
  gt02.modem_at.recovery_on_failure:
    extra_configs: [CONFIG_AT_TEST_RECOVERY=y, CONFIG_AT_TEST_RECOVERY_CASE=5]
  gt02.modem_at.recovery_budget:
    extra_configs: [CONFIG_AT_TEST_RECOVERY=y, CONFIG_AT_TEST_RECOVERY_CASE=6]
  gt02.modem_at.recovery_rearm_failure:
    extra_configs: [CONFIG_AT_TEST_RECOVERY=y, CONFIG_AT_TEST_RECOVERY_CASE=7]
  gt02.modem_at.recovery_full_queue:
    extra_configs: [CONFIG_AT_TEST_RECOVERY=y, CONFIG_AT_TEST_RECOVERY_CASE=8]
  gt02.modem_at.recovery_rearm_deadline:
    extra_configs: [CONFIG_AT_TEST_RECOVERY=y, CONFIG_AT_TEST_RECOVERY_CASE=9]
  gt02.modem_at.recovery_blocked_rearm:
    extra_configs: [CONFIG_AT_TEST_RECOVERY=y, CONFIG_AT_TEST_RECOVERY_CASE=10]
  gt02.modem_at.recovery_blocked_power_off:
    extra_configs: [CONFIG_AT_TEST_RECOVERY=y, CONFIG_AT_TEST_RECOVERY_CASE=11]
  gt02.modem_at.timeout:
    extra_configs:
      - CONFIG_AT_TEST_FAULT_CASE=0
  gt02.modem_at.partial_tx:
    extra_configs:
      - CONFIG_AT_TEST_FAULT_CASE=1
  gt02.modem_at.long_line:
    extra_configs:
      - CONFIG_AT_TEST_FAULT_CASE=2
  gt02.modem_at.long_body:
    extra_configs:
      - CONFIG_AT_TEST_FAULT_CASE=3
  gt02.modem_at.rx_error:
    extra_configs:
      - CONFIG_AT_TEST_FAULT_CASE=4
  gt02.modem_at.query_all:
    extra_configs:
      - CONFIG_AT_TEST_QUERY_ALL=y
      - CONFIG_AT_TEST_QUERY_FAULT_CASE=0
  gt02.modem_at.query_error_continue:
    extra_configs:
      - CONFIG_AT_TEST_QUERY_ALL=y
      - CONFIG_AT_TEST_QUERY_FAULT_CASE=1
  gt02.modem_at.query_timeout_stop:
    extra_configs:
      - CONFIG_AT_TEST_QUERY_ALL=y
      - CONFIG_AT_TEST_QUERY_FAULT_CASE=2
  gt02.modem_at.capability:
    extra_configs:
      - CONFIG_AT_TEST_CAPABILITY=y
  gt02.modem_at.network_registration_recovery:
    extra_configs:
      - CONFIG_AT_TEST_NETWORK=y
      - CONFIG_AT_TEST_NETWORK_CASE=0
  gt02.modem_at.network_inactive_context:
    extra_configs:
      - CONFIG_AT_TEST_NETWORK=y
      - CONFIG_AT_TEST_NETWORK_CASE=1
  gt02.modem_at.network_missing_ip:
    extra_configs:
      - CONFIG_AT_TEST_NETWORK=y
      - CONFIG_AT_TEST_NETWORK_CASE=2
  gt02.modem_at.network_query_error:
    extra_configs:
      - CONFIG_AT_TEST_NETWORK=y
      - CONFIG_AT_TEST_NETWORK_CASE=3
  gt02.modem_at.network_no_ready:
    extra_configs:
      - CONFIG_AT_TEST_NETWORK=y
      - CONFIG_AT_TEST_NETWORK_CASE=4
  gt02.modem_at.network_duplicate_ready:
    extra_configs:
      - CONFIG_AT_TEST_NETWORK=y
      - CONFIG_AT_TEST_NETWORK_CASE=5
  gt02.modem_at.network_at_timeout:
    extra_configs:
      - CONFIG_AT_TEST_NETWORK=y
      - CONFIG_AT_TEST_NETWORK_CASE=6
  gt02.modem_at.network_delayed_query_and_stale:
    extra_configs:
      - CONFIG_AT_TEST_NETWORK=y
      - CONFIG_AT_TEST_NETWORK_CASE=7
  gt02.modem_at.network_wrong_prepare_event:
    extra_configs:
      - CONFIG_AT_TEST_NETWORK=y
      - CONFIG_AT_TEST_NETWORK_CASE=8
  gt02.modem_at.network_wrong_query_event:
    extra_configs:
      - CONFIG_AT_TEST_NETWORK=y
      - CONFIG_AT_TEST_NETWORK_CASE=9
  gt02.modem_at.network_delayed_prepare:
    extra_configs:
      - CONFIG_AT_TEST_NETWORK=y
      - CONFIG_AT_TEST_NETWORK_CASE=10
  gt02.modem_at.network_fault_while_waiting:
    extra_configs:
      - CONFIG_AT_TEST_NETWORK=y
      - CONFIG_AT_TEST_NETWORK_CASE=11
  gt02.modem_at.network_prepare_rejected_retry:
    extra_configs: [CONFIG_AT_TEST_NETWORK=y, CONFIG_AT_TEST_NETWORK_CASE=12]
  gt02.modem_at.network_prepare_timeout_retry:
    extra_configs: [CONFIG_AT_TEST_NETWORK=y, CONFIG_AT_TEST_NETWORK_CASE=13]
  gt02.modem_at.network_event_overflow:
    extra_configs: [CONFIG_AT_TEST_NETWORK=y, CONFIG_AT_TEST_NETWORK_CASE=14]
  gt02.modem_at.network_prepare_error:
    extra_configs: [CONFIG_AT_TEST_NETWORK=y, CONFIG_AT_TEST_NETWORK_CASE=15]
  gt02.modem_at.network_sim_not_ready:
    extra_configs: [CONFIG_AT_TEST_NETWORK=y, CONFIG_AT_TEST_NETWORK_CASE=16]
  gt02.modem_at.network_blocked_power_on_fault:
    extra_configs: [CONFIG_AT_TEST_NETWORK=y, CONFIG_AT_TEST_NETWORK_CASE=17]
  gt02.modem_at.network_blocked_power_on_overflow:
    extra_configs: [CONFIG_AT_TEST_NETWORK=y, CONFIG_AT_TEST_NETWORK_CASE=18]
  gt02.modem_at.network_activation_wait:
    extra_configs: [CONFIG_AT_TEST_NETWORK=y, CONFIG_AT_TEST_NETWORK_CASE=19]
  gt02.modem_at.network_activation_error_retry:
    extra_configs: [CONFIG_AT_TEST_NETWORK=y, CONFIG_AT_TEST_NETWORK_CASE=20]
  gt02.modem_at.network_activation_rejected_retry:
    extra_configs: [CONFIG_AT_TEST_NETWORK=y, CONFIG_AT_TEST_NETWORK_CASE=21]
  gt02.modem_at.network_activation_after_registration:
    extra_configs: [CONFIG_AT_TEST_NETWORK=y, CONFIG_AT_TEST_NETWORK_CASE=22]
  gt02.modem_at.network_wrong_activation_event:
    extra_configs: [CONFIG_AT_TEST_NETWORK=y, CONFIG_AT_TEST_NETWORK_CASE=23]
  gt02.modem_at.network_activation_timeout_retry:
    extra_configs: [CONFIG_AT_TEST_NETWORK=y, CONFIG_AT_TEST_NETWORK_CASE=24]
  gt02.modem_at.network_activation_fault_and_late_result:
    extra_configs: [CONFIG_AT_TEST_NETWORK=y, CONFIG_AT_TEST_NETWORK_CASE=25]
```
